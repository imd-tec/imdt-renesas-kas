## Kconfig
```kconfig
# IMDT Renesas BSP - Development Configuration

mainmenu "IMDT Renesas BSP"

config KAS_BUILD_SYSTEM
    string
    default "openembedded"

# =============================================================================
# Base Configuration (always included)
# =============================================================================
config KAS_INCLUDE_BASE
    string
    default "includes/base.yml"
    help
      Base layer configuration - always included first.
      Defines poky, meta-openembedded, meta-renesas and other core layers.

config KAS_INCLUDE_IMDT
    string
    default "includes/imdt.yml"
    help
      IMDT layer configuration - always included.

config KAS_INCLUDE_MACHINE
    string
    default "machine/v2h.yml"
    help
      Machine configuration - always included.
      Defines the target machine (V2H).

# =============================================================================
# AI/ML Acceleration Features
# =============================================================================
menu "AI/ML Acceleration"

config V2H_DRPAI
    bool "DRP-AI (V2H)"
    default y
    help
      Enable DRP-AI acceleration for V2H.

config KAS_INCLUDE_V2H_DRPAI
    string
    depends on V2H_DRPAI
    default "features/v2h-drpai.yml"

config V2H_ACCEL_ENABLE
    bool "Enable Codec/OpenCVA (V2H)"
    default y
    help
      Enable hardware acceleration selection for V2H.
      Choose between Video Codecs or OpenCV Accelerator.

if V2H_ACCEL_ENABLE

choice
    prompt "V2H Codec/OpenCVA Selection"
    default V2H_CODECS

config V2H_CODECS
    bool "Video Codecs (proprietary)"
    help
      Enable hardware video codec support for V2H.

config V2H_OPENCVA
    bool "OpenCV Accelerator"
    help
      Enable OpenCV hardware acceleration for V2H.

endchoice

endif # V2H_ACCEL_ENABLE

config KAS_INCLUDE_V2H_CODECS
    string
    depends on V2H_CODECS
    default "features/codecs.yml"

config KAS_INCLUDE_V2H_OPENCVA
    string
    depends on V2H_OPENCVA
    default "features/v2h-opencva.yml"


endmenu

# =============================================================================
# Target Image
# =============================================================================
menu "Target Image"

choice
    prompt "Image type"
    default IMAGE_WESTON

config IMAGE_WESTON
    bool "Weston (Wayland compositor)"
    help
      Build a graphical image with Weston compositor.

config IMAGE_CORE
    bool "Core (minimal)"
    help
      Build a minimal console image.

endchoice

config KAS_INCLUDE_IMAGE
    string
    default "images/weston.yml" if IMAGE_WESTON
    default "images/core.yml" if IMAGE_CORE

endmenu
```
